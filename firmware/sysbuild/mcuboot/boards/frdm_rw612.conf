## firmware/sysbuild/mcuboot/boards/frdm_rw612.conf
```kconfig
# Enable logging so MCUBOOT_LOG_LEVEL_WRN choice is active
CONFIG_LOG=y

# Enable flash subsystem so FLASH_HAS_DRIVER_ENABLED=y, satisfying FLASH_MAP dependency
CONFIG_FLASH=y
CONFIG_FLASH_MAP=y

# MCUboot default prj.conf is not used in sysbuild; set required stack size explicitly
CONFIG_MAIN_STACK_SIZE=10240
```
